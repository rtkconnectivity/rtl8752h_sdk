## board/evb/io_sample/QSPI/src/Kconfig
```kconfig
menu "Hardware Drivers Config"

config SOC_RTL_8762D
    bool
    select RT_USING_COMPONENTS_INIT
    select ARCH_ARM_CORTEX_M4
    default y

menu "BLE ATT Config"
    menuconfig RTK_BLE_TASK
        bool "RTK BLE TASK"
        default n
		if RTK_BLE_TASK
			menuconfig RTK_BLE_WRISTBAND
				bool "RTK BLE WRISTBAND"
				default n
			menuconfig RTK_BLE_THROUGHPUT
				bool "RTK BLE THROUGHPUT"
				default n
			menuconfig MODULE_OTA_MASTER
				bool "RTK BLE OTA MASTER"
				default n
			menuconfig TUYA_BLE_SDK
				bool "TUYA BLE SDK"
				default n
				select MODULE_USING_DATABASE
			menuconfig RTK_MI_WEAR
				bool "XIAOMI WEAR"
				default n
			menuconfig MODULE_ALI_IOT
				bool "Ali upay and transport"
				default n
		endif
endmenu

menu "On-chip Peripheral Drivers"

    menuconfig BSP_USING_UART
        bool "Enable UART"
        default y
        select RT_USING_SERIAL
        if BSP_USING_UART
            config BSP_USING_UART0
                bool "Enable UART0"
                default y
            config BSP_USING_UART1
                bool "Enable UART1"
                default y
        endif

    menuconfig BSP_USING_TOUCH
        bool "Enable Touch"
        default n

    menuconfig BSP_USING_LCD
        bool "Enable LCD"
        default n

    menuconfig BSP_USING_PSRAM
        bool "Enable psram"
        default n

    menuconfig BSP_USING_SPI_NAND
        bool "Enable SPI NAND"
        default n
    menuconfig BSP_USING_SPI
        bool "Enable DW SPI"
        default n
    menuconfig BSP_USING_ADC
        bool "Enable DW ADC"
        default n
    menuconfig BSP_USING_DMIC
        bool "Enable DW DMIC"
        default n
    menuconfig BSP_USING_SPIC_FLASH
        bool "Enable DW SPIC"
        default n

    menuconfig BSP_USING_BLE
        bool "Enable BLE"
        default n
        if BSP_USING_BLE
                config BSP_USING_REALTEK_BLE
                    bool "Enable REALTEK BLE"
                    default y
                config BSP_USING_BSAL
                    select PKG_USING_BSAL
                    bool "Enable BSAL BLE"
                    default n
        endif

    menuconfig BSP_USING_MSPI_FLASH
        bool "Enable mspi flash"
        default n

    menuconfig BSP_USING_PIN
        select RT_USING_PIN
        bool "Enable PIN device"
        default n

    menuconfig BSP_USING_I2C
        select RT_USING_I2C
        bool "Enable I2C Bus"
        default n

        if BSP_USING_I2C
                config BSP_USING_I2C1
                    bool "Enable I2C1"
                    default y
        endif

endmenu

menu "Board extended module Drivers"
    menuconfig MODULE_USING_CWM
        bool "MODULE USING CWM"
        default n
    menuconfig MODULE_USING_DATABASE
        bool "MODULE USING DATABASE"
        default n
    menuconfig MODULE_USING_RTK_ALGO
        bool "MODULE USING RTK Gsensor ALGO"
        default n
    menuconfig BSP_USING_LCD_DRIVER_IC
        bool "Enable LCD Module Driver IC"
        default n
        if BSP_USING_LCD_DRIVER_IC
			choice
				prompt "select one driver ic and interface"
				default BSP_USING_RTK_SPI_LCD_R_PI

				config BSP_USING_RTK_QSPI_LCD_454
					select BSP_USING_LCD
					bool "Enable QSPI LCD"

				config BSP_USING_RTK_8080_LCD_320
					select BSP_USING_LCD
					bool "Enable 8080 LCD 320*320"
				config BSP_USING_RTK_SPI_LCD_R_PI
					select BSP_USING_LCD
					bool "Enable SPI LCD 240*320"
				config BSP_USING_RTK_77903_400
					select BSP_USING_LCD
					bool "Enable QSPI 77903 400*400"
			endchoice
        endif
    menuconfig MODULE_USING_RTK_GUI
        bool "MODULE USING RTK GUI"
		select BSP_USING_LCD_DRIVER_IC
        default n
        if MODULE_USING_RTK_GUI
			choice
				prompt "select frame buffer type"
				default RTK_GUI_FB_RAMLESS

				config RTK_GUI_FB_RAMLESS
					select BSP_USING_LCD
					bool "Enable FB_RAMLESS MODE"

				config RTK_GUI_FB_RAM_DOUBLE
					select BSP_USING_LCD
					select BSP_USING_PSRAM
					bool "Enable FB_RAM_DOUBLE MODE"
				config FB_RAM_SINGLE
					select BSP_USING_LCD
					select BSP_USING_PSRAM
					bool "Enable FB_RAM_SINGLE MODE"
			endchoice
		menuconfig MODULE_USING_RTK_GUI_DEMO
			bool "MODULE RTK GUI DEMO"
			default n

        endif
    menuconfig MODULE_USING_PORT_FOR_LVGL
        bool "MODULE PORT FOR LVGL"
        default n
    menuconfig MODULE_USING_ARM_2D
        bool "MODULE ARM 2D"
        default n
    menuconfig MODULE_OFFLINE_VOICE
		select BSP_USING_DMIC
        bool "MODULE OFFLINE VOICE"
        default n
endmenu

endmenu
```
